## Kconfig
```kconfig
mainmenu "Lunar 0.01 Configuration"

choice
	prompt "Architecture"
	default ARCH_X86_64

config ARCH_X86_64
	bool "x86_64"

endchoice

config ARCH
	string
	default "x86_64" if ARCH_X86_64

menu "Build options"

config DEBUG
	bool "Add debug symbols"
	default n
	help
	  "Add debug symbols in the kernel binary"

config OPTIMIZATION
	int "Set optimization level"
	range 0 3
	default 2
	help
	  "Set the optimization level for the compiler"
	  "0: No optimization (good for debugging)"
	  "1: Enables minimal optimizations"
	  "2: Enables a good in between of optimizations (default)"
	  "3: Enables aggresive optimizations"

config UBSAN
	bool "Enable undefined behavior sanitizer"
	default n
	help
	  "Enable runtime checks for undefined behavior"

config KASLR
	bool "Enable randomization of kernel addresses (KASLR)"
	default y
	help
	  "Enables build options that allow the kernel to be ran at any memory address"

endmenu

source "kernel/Kconfig"

if ARCH_X86_64
source "arch/x86_64/Kconfig"
endif

source "drivers/Kconfig"
```

## drivers/acpi/Kconfig
```kconfig
menu "ACPI"

config DRIVER_ACPI_ENABLE_TABLES
	bool "Enable ACPI Table parser"
	default y
	help
	  "If you do not know what this is, leave it enabled"

config DRIVER_ACPI_ENABLE_AML
	bool "Enable ACPI AML interpreter"
	depends on DRIVER_ACPI_ENABLE_TABLES
	default y
	help
	  "If you do not know what this is, leave it enabled."

config DRIVER_ACPI_ENABLE_EC
	bool "Enable ACPI EC device"
	depends on DRIVER_ACPI_ENABLE_AML
	default y
	help
	  "Allows ACPI to use the EC for things like the power button and battery"

endmenu
```

## drivers/acpi/ec/Kconfig
```kconfig
config DRIVER_ACPI_EC
	bool "Enable the embedded controller driver"
	default y
	help
	  "Enables the ACPI embedded controller driver"
```

## drivers/acpi/i8042/Kconfig
```kconfig
config DRIVER_ACPI_I8042
	bool "Enable the i8042 driver"
	default y
	help
	  "Enables the i8042 driver (PS/2)"
```

## drivers/e9hack/Kconfig
```kconfig
config DRIVER_E9HACK
	bool "Enable port E9 hack"
	default y
	help
	  "This driver allows writing printk messages to port e9 for hypervisors"
```

## drivers/io/i8042/Kconfig
```kconfig
config DRIVER_ACPI_I8042
	bool "Enable the i8042 driver"
	depends on ARCH_X86_64
	default y
	help
	  "Enables the i8042 driver (PS/2)"
```

## drivers/liminefb/Kconfig
```kconfig
config DRIVER_LIMINEFB
	bool "Enable support for limine framebuffers"
	default y
	help
	  "This driver is for basic video output"
```

## drivers/pci/Kconfig
```kconfig
config DRIVER_PCI
	bool "Enable support for PCI/PCIe"
	default y
	help
	  "This driver allows support for PCI/PCIe devices"
```

## fs/initrd/Kconfig
```kconfig
config FS_INITRD
	bool "initrd"
	default y
	help
	  "Enable initial ramdisk support"
```

## fs/tmpfs/Kconfig
```kconfig
config FS_TMPFS
	bool "tmpfs"
	default y
	help
	  "Enable temporary file system support"
```

## kernel/Kconfig
```kconfig
menu "Kernel setup"

config PRINTK_LEVEL
	int "Set printk level"
	range 1 6
	default 3
	help
	  "Set boot time printk level"

config SMP
	bool "Enable SMP"
	default y
	help
	  "Enable symmetric multiprocessing"

endmenu
```
