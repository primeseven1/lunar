## arch/x86_64/Kconfig
```kconfig
menu "x86_64 options"

config ARCH_X86_64_E9HACK
	bool "Enable debug port 0xe9"
	default n
	help
	  "Allow a virtual machine to write logs to the host"

config ARCH_X86_64_X2APIC
	bool "Enable X2APIC"
	default n
	help
	  "Use x2apic"

config ARCH_X86_64_RETPOLINE
	bool "Enable return trampolines"
	default y
	help
	  "Enable the retpoline mitigation for spectre-v2"

endmenu
```

## drivers/Kconfig
```kconfig
menu "Device drivers"
source "drivers/acpi/Kconfig"
source "drivers/io/Kconfig"
source "drivers/liminefb/Kconfig"
endmenu
```
